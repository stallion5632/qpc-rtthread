## ports/rt-thread/rtmpool/Kconfig
```kconfig
menuconfig QF_ENABLE_RT_MEMPOOL
    bool "Enable RT-Thread memory pool for QPC event pools"
    default n
    help
        This option enables the use of RT-Thread memory pool (rt_mempool)
        as the backend for QP/C event pools, providing zero-intrusion
        integration between RT-Thread and QP/C memory management.

if QF_ENABLE_RT_MEMPOOL

config QF_RTMPOOL_DEBUG
    bool "Enable RT-Thread memory pool debug features"
    default n
    help
        Enables debug features for RT-Thread memory pool adapter:
        - Usage tracking (current and peak memory allocation)
        - Debug output during allocation/free operations
        - Memory statistics functions

endif

config QPC_USING_RTMPOOL_DEMO
    bool "Enable RT-Thread memory pool integration demo"
    default n
    select QF_ENABLE_RT_MEMPOOL
    help
        Demonstrates the usage of RT-Thread memory pool as the backend
        for QP/C event pools.
```
